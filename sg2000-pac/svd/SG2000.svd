# SG2000 register map
Vendor: Sophgo; File version: 1
64-bit RISC-V Processor
Registers are 32-bit, read-write, reset 0x0 unless marked. A register's access mark holds for its fields unless they carry their own. Offsets are from the block's base; lines under a group give offsets from that group; [hi:lo] are bit positions; {n}, {i} and the like mark numbered series; 'fields as' and 'values as' point back to an identical list; <NAME> marks a mode.

## Memory map
0x01900000 mailboxes
0x03020000 GPIO0 size 0x64
0x03021000 GPIO1 size 0x64
0x03022000 GPIO2 size 0x64
0x03023000 GPIO3 size 0x64
0x04140000 UART0 size 0xAC — UART
0x04150000 UART1 size 0xAC
0x04160000 UART2 size 0xAC
0x04170000 UART3 size 0xAC
0x041C0000 UART4 size 0xAC
0x05021000 RTCSYS_GPIO size 0x64
0x05022000 RTCSYS_UART size 0xAC
0x70000000 plic size 0x4000000 — Platform-Level Interrupt Controller
0x74000000 CLINT size 0x4100000 — Core Local Interrupt Controller (XuanTie C906)

## Interrupts
30 UART0
31 UART1
41 GPIO0
42 GPIO1
43 GPIO2
44 GPIO3
61 MBOX (mailboxes)

## plic — Platform-Level Interrupt Controller
Base 0x70000000
{0x0+4i} PLIC_PRIO[{i}] (i=0..1023) — Interrupt Priority Register (1-1023)
  [4:0] PRIO — Interrupt Priority (0-31)
{0x1000+4i} PLIC_IP[{i}] (i=0..31) reset not defined — Interrupt Pending Register
  [31:0] IP — Interrupt Pending Bits
{0x2000+4i} PLIC_H0_MIE[{i}] (i=0..31) reset not defined — M-mode Interrupt Enable Register
  [31:0] IE — Interrupt Enable Bits
{0x2080+4i} PLIC_H0_SIE[{i}] (i=0..31) reset not defined — S-mode Interrupt Enable Register
  [31:0] IE — Interrupt Enable Bits
{0x2100+4i} PLIC_H1_MIE[{i}] (i=0..31) reset not defined — Hart 1 M-mode Interrupt Enable Register
  [31:0] IE — Interrupt Enable Bits
{0x2180+4i} PLIC_H1_SIE[{i}] (i=0..31) reset not defined — Hart 1 S-mode Interrupt Enable Register
  [31:0] IE — Interrupt Enable Bits
0x1FFFFC PLIC_PER reset not defined — PLIC Permission Control Register
  [0] S_PER — S-mode Access Permission (0: M-mode only, 1: M/S modes)
0x200000 PLIC_H0_MTH reset not defined — M-mode Interrupt Threshold Register
  [31:0] THRESHOLD
0x200004 PLIC_H0_MCLAIM — M-mode Interrupt Claim/Complete Register
  [31:0] CLAIM_ID
0x201000 PLIC_H0_STH — S-mode Interrupt Threshold Register
  [31:0] THRESHOLD
0x201004 PLIC_H0_SCLAIM — S-mode Interrupt Claim/Complete Register
  [31:0] CLAIM_ID
0x202000 PLIC_H1_MTH reset not defined — Hart 1 M-mode Interrupt Threshold Register
  [31:0] THRESHOLD
0x202004 PLIC_H1_MCLAIM — Hart 1 M-mode Interrupt Claim/Complete Register
  [31:0] CLAIM_ID
0x203000 PLIC_H1_STH — Hart 1 S-mode Interrupt Threshold Register
  [31:0] THRESHOLD
0x203004 PLIC_H1_SCLAIM — Hart 1 S-mode Interrupt Claim/Complete Register
  [31:0] CLAIM_ID

## CLINT — Core Local Interrupt Controller (XuanTie C906)
Base 0x74000000
0x00 MSIP0 — M-mode Software Interrupt Pending
  [0] MSIP — Machine Software Interrupt Pending
0x4000 MTIMECMPL0 reset 0xFFFFFFFF — M-mode Timer Compare Low
0x4004 MTIMECMPH0 reset 0xFFFFFFFF — M-mode Timer Compare High
0xC000 SSIP0 — S-mode Software Interrupt Pending
  [0] SSIP — Supervisor Software Interrupt Pending
0xD000 STIMECMPL0 reset not defined — S-mode Timer Compare Low
0xD004 STIMECMPH0 reset not defined — S-mode Timer Compare High

## GPIO0
Base 0x03020000
Same registers: GPIO1 0x03021000, GPIO2 0x03022000, GPIO3 0x03023000, RTCSYS_GPIO 0x05021000
0x00 DR — Data Register
0x04 DDR — Data Direction Register
0x30 INTEN — Interrupt Enable Register
0x34 INTMASK — Interrupt Mask Register
0x38 INTTYPE_LEVEL — Interrupt Level Register
0x3C INT_POLARITY — Interrupt Polarity Register
0x40 INTSTATUS ro reset not defined — Interrupt Status Register
0x44 RAW_INTSTATUS ro reset not defined — Raw (pre-masking) Interrupt Status Register
0x48 DEBOUNCE — Debounce Enable Register
0x4C EOI — Clear Interrupt Register
0x50 EXT ro reset not defined — External Port Register
0x60 LS_SYNC — Level-Sensitive Synchronization Enable Register
  [0] LS_SYNC — Synchronize all level-sensitive interrupt to pclk_intr
